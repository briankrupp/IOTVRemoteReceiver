/* DIRECTIONS:
 * 1. Get new signals using IRdump program and using your TV remote
 * 2. Replace data for each button below that corresponds to IOTVRemote
 * 3. Enter SSID and Password below
 */
#include <IRrecv.h>
#include <IRremoteESP8266.h>
#include <IRsend.h>
#include <IRtimer.h>
#include <IRutils.h>
#include <ir_Argo.h>
#include <ir_Coolix.h>
#include <ir_Daikin.h>
#include <ir_Fujitsu.h>
#include <ir_Gree.h>
#include <ir_Haier.h>
#include <ir_Kelvinator.h>
#include <ir_LG.h>
#include <ir_Magiquest.h>
#include <ir_Midea.h>
#include <ir_Mitsubishi.h>
#include <ir_NEC.h>
#include <ir_Panasonic.h>
#include <ir_Samsung.h>
#include <ir_Toshiba.h>
#include <ir_Trotec.h>

#include <ESP8266WiFi.h>
 
const char* ssid = "ENTER_SSID_HERE";
const char* password = "ENTER_PSK_HERE";

int IR_LED = 14; // GPPIO 14 D5
WiFiServer server(80);
decode_results results;
IRsend irsend(IR_LED);

void power() {
  uint16_t rawData[135] = {8990, 4444,  576, 550,  574, 1656,  576, 550,  574, 1656,  576, 550,  576,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 552,  574};  // NEC 57E3E817
  uint32_t address = 0xC7EA;
  uint32_t command = 0x17;
  uint64_t data = 0x57E3E817;
  irsend.sendRaw(rawData, 135, 38); 
}
void downArrow() {
  uint16_t rawData[135] = {8990, 4440,  590, 536,  576, 1652,  580, 548,  602, 1626,  578, 550,  576,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 550,  578};  // NEC 57E3CC33
  uint32_t address = 0xC7EA;
  uint32_t command = 0x33;
  uint64_t data = 0x57E3CC33;
  irsend.sendRaw(rawData, 135, 38); 
}
void upArrow() {
  uint16_t rawData[135] = {8990, 4444,  574, 550,  576, 1654,  576, 552,  574, 1654,  576, 552,  574,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 552,  574};  // NEC 57E39867
  uint32_t address = 0xC7EA;
  uint32_t command = 0x19;
  uint64_t data = 0x57E39867;
  irsend.sendRaw(rawData, 135, 38); 
}
void leftArrow() {
  uint16_t rawData[135] = {9016, 4416,  604, 520,  602, 1628,  604, 522,  578, 1652,  604, 522,  604,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 546,  604};  // NEC 57E37887
  uint32_t address = 0xC7EA;
  uint32_t command = 0x1E;
  uint64_t data = 0x57E37887;
  irsend.sendRaw(rawData, 135, 38); 
}
void rightArrow() {
  uint16_t rawData[135] = {9016, 4418,  578, 548,  578, 1654,  578, 548,  578, 1652,  576, 548,  580,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 548,  594};  // NEC 57E3B44B
  uint32_t address = 0xC7EA;
  uint32_t command = 0x2D;
  uint64_t data = 0x57E3B44B;
  irsend.sendRaw(rawData, 135, 38); 
}
void okButton() {
  uint16_t rawData[135] = {8988, 4442,  576, 548,  576, 1656,  574, 552,  574, 1656,  576, 550,  576,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 550,  576};  // NEC 57E354AB
uint32_t address = 0xC7EA;
uint32_t command = 0x2A;
uint64_t data = 0x57E354AB;
  irsend.sendRaw(rawData, 135, 38); 
}
void menu() {
  uint16_t rawData[71] = {8954, 4440,  592, 522,  592, 1640,  592, 1638,  594, 522,  592, 522,  592,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 2226,  594};  // NEC 61A028D7
  uint32_t address = 0x586;
  uint32_t command = 0x14;
  uint64_t data = 0x61A028D7;
  irsend.sendRaw(rawData, 71, 38); 
}
void channelUp() {

  //irsend.sendRaw(rawData, 71, 38); 
}
void channelDown() {

  //  irsend.sendRaw(rawData, 71, 38); 
}
void volumeUp() {
  // Below comment is for TCL Native Volume
//  uint16_t rawData[71] = {8956, 4438,  596, 518,  620, 1610,  598, 1634,  598, 516,  596, 516,  598,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 2228,  596};  // NEC 61A030CF
//  uint32_t address = 0x586;
//  uint32_t command = 0xC;
//  uint64_t data = 0x61A030CF;

  // Sound Bar
  uint16_t  rawData[67] = {9000,4400, 600,500, 600,500, 600,550, 600,500, 600,500, 600,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1650, 550};  // NEC FF827D
  unsigned int   data = 0xFF827D;

  irsend.sendRaw(rawData, 67, 38); 
}
void volumeDown() {
  // Below comment is for TCL Native Volume
//  uint16_t rawData[135] = {8986, 4442,  574, 550,  574, 1654,  576, 550,  574, 1652,  578, 552,  574,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 548,  576};  // NEC 57E308F7
//  uint32_t address = 0xC7EA;
//  uint32_t command = 0x10;
//  uint64_t data = 0x57E308F7;

  // Sound Bar
  uint16_t   rawData[67] = {8950,4450, 600,500, 600,550, 550,550, 600,550, 550,500, 600,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1650, 600};  // NEC FFA25D
  unsigned int  data = 0xFFA25D;

  irsend.sendRaw(rawData, 67, 38); 
}
void mute() {
  // Below comment is for TCL Native Volume
//  uint16_t rawData[135] = {8990, 4440,  578, 548,  576, 1654,  578, 548,  578, 1652,  578, 548,  578,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 548,  578};  // NEC 57E304FB
//  uint32_t address = 0xC7EA;
//  uint32_t command = 0x20;
//  uint64_t data = 0x57E304FB;

  uint16_t   rawData[67] = {9000,4350, 650,500, 600,500, 600,550, 600,500, 600,550, 550,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1600, 600};  // NEC FF12ED
  unsigned int  data = 0xFF12ED;

  irsend.sendRaw(rawData, 67, 38); 
}

void backButton() {
  uint16_t rawData[135] = {8988, 4440,  576, 550,  576, 1654,  574, 552,  574, 1654,  576, 550,  576,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 550,  576};  // NEC 57E36699
  uint32_t address = 0xC7EA;
  uint32_t command = 0x66;
  uint64_t data = 0x57E36699;
  irsend.sendRaw(rawData, 135, 38); 
}

void playPause() {
  uint16_t rawData[135] = {8990, 4438,  602, 522,  578, 1650,  580, 548,  576, 1652,  602, 524,  580,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 546,  602};  // NEC 57E332CD
  uint32_t address = 0xC7EA;
  uint32_t command = 0x4C;
  uint64_t data = 0x57E332CD;
  irsend.sendRaw(rawData, 135, 38); 
}
void goBack() {
  uint16_t rawData[135] = {8992, 4436,  578, 546,  578, 1650,  578, 550,  576, 1652,  602, 524,  576,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 548,  578};  // NEC 57E31EE1
  uint32_t address = 0xC7EA;
  uint32_t command = 0x78;
  uint64_t data = 0x57E31EE1;
  irsend.sendRaw(rawData, 135, 38); 
}
void goRewind() {
  uint16_t rawData[135] = {8986, 4442,  576, 548,  574, 1654,  576, 550,  576, 1652,  578, 550,  576,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 550,  576};  // NEC 57E32CD3
  uint32_t address = 0xC7EA;
  uint32_t command = 0x34;
  uint64_t data = 0x57E32CD3;
  irsend.sendRaw(rawData, 135, 38); 
}
void goForward() {
  uint16_t rawData[135] = {8986, 4440,  576, 548,  576, 1654,  576, 550,  576, 1652,  576, 550,  576,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 550,  576};  // NEC 57E3AA55
  uint32_t address = 0xC7EA;
  uint32_t command = 0x55;
  uint64_t data = 0x57E3AA55;
  irsend.sendRaw(rawData, 135, 38); 
}
void starButton() {
  uint16_t rawData[135] = {8990, 4442,  574, 550,  576, 1654,  576, 548,  576, 1654,  576, 550,  576,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 550,  574};  // NEC 57E38679
  uint32_t address = 0xC7EA;
  uint32_t command = 0x61;
  uint64_t data = 0x57E38679;
  irsend.sendRaw(rawData, 135, 38); 
}



void setup() {
  Serial.begin(115200);
  delay(10);
 
  Serial.print("Attempting connection to: ");
  Serial.println(ssid);
 
  WiFi.begin(ssid, password);
 
  while (WiFi.status() != WL_CONNECTED) {
    delay(500);
  }

  Serial.println("Connected!");
 
  server.begin();
 
  // Print the IP address
  Serial.print("Listening on the following IP, enter this into IOTVRemote: ");
  Serial.print(WiFi.localIP());
  irsend.begin();
 
}
 
void loop() {
  // Check if a client has connected
  WiFiClient client = server.available();
  if (!client) {
    return;
  }
 
  while(!client.available()){
    delay(1);
  }
 
  // Read the first line of the request
  String request = client.readStringUntil('\r');
  Serial.println(request);
  client.flush();
 
  // Match the request
  if (request.indexOf("/power") != -1)  {
    power();
  }
  else if (request.indexOf("/downArrow") != -1)  {
    downArrow();
  }
  else if (request.indexOf("/upArrow") != -1)  {
    upArrow();
  }
  else if (request.indexOf("/leftArrow") != -1)  {
    leftArrow();
  }
  else if (request.indexOf("/rightArrow") != -1)  {
    rightArrow();
  }
  else if (request.indexOf("/okButton") != -1)  {
    okButton();
  }
  else if (request.indexOf("/menu") != -1)  {
    menu();
  }
  else if (request.indexOf("/volumeUp") != -1)  {
    volumeUp();
  }
  else if (request.indexOf("/volumeDown") != -1)  {
    volumeDown();
  }
  else if (request.indexOf("/mute") != -1)  {
    mute();
  }
  else if (request.indexOf("/backButton") != -1)  {
    backButton();
  }
  else if (request.indexOf("/playPause") != -1)  {
    playPause();
  }
  else if (request.indexOf("/goBack") != -1)  {
    goBack();
  }
  else if (request.indexOf("/goRewind") != -1)  {
    goRewind();
  }
  else if (request.indexOf("/goForward") != -1)  {
    goForward();
  }
  else if (request.indexOf("/starButton") != -1)  {
    starButton();
  }


  // Return the response
  client.println("HTTP/1.1 200 OK");
  client.println("Content-Type: text/html");
  client.println(""); //  do not forget this one
  
  client.println("1");
  delay(1); 
}
 
